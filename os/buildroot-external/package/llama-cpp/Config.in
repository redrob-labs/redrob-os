## os/buildroot-external/package/llama-cpp/Config.in
```kconfig
config BR2_PACKAGE_LLAMA_CPP
	bool "llama-cpp (router inference server)"
	depends on BR2_INSTALL_LIBSTDCPP
	depends on BR2_TOOLCHAIN_HAS_THREADS
	help
	  llama.cpp OpenAI-compatible inference server (llama-server),
	  CPU backend only. Serves the on-device ~1B router model that the
	  local-inference module supervises and the agent falls back to when
	  Redrob Console is unreachable. Built without libcurl and OpenMP to
	  keep the device dependency surface minimal.

	  https://github.com/ggml-org/llama.cpp

comment "llama-cpp needs a toolchain w/ C++ and threads"
	depends on !BR2_INSTALL_LIBSTDCPP || !BR2_TOOLCHAIN_HAS_THREADS
```

## os/buildroot-external/package/redrob-agent/Config.in
```kconfig
config BR2_PACKAGE_REDROB_AGENT
	bool "Redrob Agent"
	help
	  Resident agent runtime (agent/ in the monorepo). The binary is
	  built with cargo outside Buildroot and installed from
	  BR2_PACKAGE_REDROB_AGENT_BINARY, together with its systemd unit,
	  config template and the first-boot identity script from deploy/.

if BR2_PACKAGE_REDROB_AGENT

config BR2_PACKAGE_REDROB_AGENT_BINARY
	string "Path to the prebuilt agent binary"
	default "$(BR2_EXTERNAL_HAOS_PATH)/../../agent/target/release/zeroclaw"
	help
	  Absolute path (make variables allowed) to the cargo-built agent
	  for the target architecture.

endif
```

## os/buildroot-external/package/redrob-broker/Config.in
```kconfig
config BR2_PACKAGE_REDROB_BROKER
	bool "Redrob Credential Broker"
	depends on BR2_PACKAGE_REDROB_AGENT
	help
	  Holds OAuth tokens and API keys outside the agent and the sandbox,
	  serves scoped vendor calls over a Unix socket and runs the agent's
	  egress proxy (modules/credential-broker/broker). Built with cargo
	  outside Buildroot and installed from BR2_PACKAGE_REDROB_BROKER_BINARY
	  with its systemd unit and /etc/redrob/broker.toml from deploy/.

if BR2_PACKAGE_REDROB_BROKER

config BR2_PACKAGE_REDROB_BROKER_BINARY
	string "Path to the prebuilt broker binary"
	default "$(BR2_EXTERNAL_HAOS_PATH)/../../modules/credential-broker/broker/target/release/redrob-broker"

endif
```

## os/buildroot-external/package/redrob-data/Config.in
```kconfig
config BR2_PACKAGE_REDROB_DATA
	bool "Redrob data partition image"
	depends on BR2_PACKAGE_HOST_E2FSPROGS
	help
	  Builds data.ext4, the initial content of the writable data
	  partition, from a plain directory with mke2fs -d. Needs neither
	  root nor a container engine. Replaces the upstream supervisor
	  data-partition builder.
```

## os/buildroot-external/package/redrob-display/Config.in
```kconfig
config BR2_PACKAGE_REDROB_DISPLAY
	bool "Redrob display module (kiosk)"
	depends on BR2_PACKAGE_REDROB_AGENT
	select BR2_PACKAGE_DEJAVU
	select BR2_PACKAGE_DEJAVU_SANS
	help
	  Display module, kiosk mode (modules/display/kiosk): draws the agent
	  dashboard (service states, pairing code and QR) straight to KMS with
	  dumb buffers and grabs every input device. Runs as redrob-display,
	  the only user in the video and input groups. Skipped unless
	  /mnt/data/redrob/display/mode says "kiosk".

if BR2_PACKAGE_REDROB_DISPLAY

config BR2_PACKAGE_REDROB_DISPLAY_BINARY
	string "Path to the prebuilt display binary"
	default "$(BR2_EXTERNAL_HAOS_PATH)/../../modules/display/kiosk/target/release/redrob-display"

endif
```

## os/buildroot-external/package/redrob-local-inference/Config.in
```kconfig
config BR2_PACKAGE_REDROB_LOCAL_INFERENCE
	bool "Redrob local-inference module (router)"
	depends on BR2_PACKAGE_REDROB_AGENT
	select BR2_PACKAGE_LLAMA_CPP
	help
	  Local-inference module (modules/local-inference): supervises the
	  llama.cpp server that serves the on-device ~1B router model on
	  loopback (127.0.0.1:8081). The agent uses it as its offline fallback
	  provider when Redrob Console is unreachable. The GGUF model is
	  provisioned separately from OTA under /mnt/data/redrob/models; the
	  supervisor waits for it and relaunches the server if it exits.

if BR2_PACKAGE_REDROB_LOCAL_INFERENCE

config BR2_PACKAGE_REDROB_LOCAL_INFERENCE_BINARY
	string "Path to the prebuilt supervisor binary"
	default "$(BR2_EXTERNAL_HAOS_PATH)/../../modules/local-inference/supervisor/target/release/redrob-local-inference"

endif
```

## os/buildroot-external/package/redrob-pairing/Config.in
```kconfig
config BR2_PACKAGE_REDROB_PAIRING
	bool "Redrob pairing banner"
	depends on BR2_PACKAGE_REDROB_AGENT
	help
	  First-boot pairing banner (tools/redrob-pairing): device id,
	  address, the agent's one-time pairing code and a QR code, written
	  to /run/issue.d for every login prompt and /run/redrob/pairing.json
	  for the display module. Refreshed by a timer.

if BR2_PACKAGE_REDROB_PAIRING

config BR2_PACKAGE_REDROB_PAIRING_BINARY
	string "Path to the prebuilt pairing binary"
	default "$(BR2_EXTERNAL_HAOS_PATH)/../../tools/redrob-pairing/target/release/redrob-pairing"

endif
```

## os/buildroot-external/package/redrob-usb-broker/Config.in
```kconfig
config BR2_PACKAGE_REDROB_USB_BROKER
	bool "Redrob USB Broker"
	depends on BR2_PACKAGE_REDROB_AGENT
	help
	  Default-deny admission for hot-plugged USB devices via the kernel's
	  authorized_default, user approval over a Unix socket, BadUSB
	  (storage + HID) rejection and read-only automount of approved
	  storage (modules/usb-broker/broker). Built with cargo outside
	  Buildroot; installed from BR2_PACKAGE_REDROB_USB_BROKER_BINARY.

if BR2_PACKAGE_REDROB_USB_BROKER

config BR2_PACKAGE_REDROB_USB_BROKER_BINARY
	string "Path to the prebuilt usb broker binary"
	default "$(BR2_EXTERNAL_HAOS_PATH)/../../modules/usb-broker/broker/target/release/redrob-usb-broker"

endif
```
